## conf/machine/at572d940hfek.conf
```bitbake
#@TYPE: Machine
#@Name: Atmel AT572D940HFEK Development Platform
#@DESCRIPTION: Machine configuration for the at572d940hfek development board with a at572d940hf processor
# AT91Bootstrap not yet functional

include conf/machine/include/AT91.inc

# Has no linux config file in OpenEmbedded
LINUX26_CONFIG = "at572d940hf_defconfig"
UBOOT_MACHINE = "at572d940hfek_config"
AT91BOOTSTRAP_BOARD = "at572d940hfek"

MACHINE_FEATURES += "usbhost"
```

## conf/machine/at91cap9stk.conf
```bitbake
#@TYPE: Machine
#@Name: Atmel AT91CAP9ADK Development Platform
#@DESCRIPTION: Machine configuration for the at91cap9adk development board with a at91cap9500 processor


include conf/machine/include/AT91-LCD.inc

# Has no linux config file in OpenEmbedded
LINUX26_DEFCONFIG = "at91cap9adk_defconfig"
UBOOT_MACHINE = "at91cap9adk_config"
AT91BOOTSTRAP_BOARD = "at91cap9stk"

MACHINE_FEATURES += "usbhost"
```

## conf/machine/at91sam9260df.conf
```bitbake
#@TYPE: Machine
#@Name: Atmel AT91SAM9260EK Development Platform
#@DESCRIPTION: Machine configuration for the at91sam9260ek development board with a at91sam9260 processor
#@This configuration will boot from the internal dataflash

include conf/machine/include/AT91.inc

# Has no linux config file in OpenEmbedded
LINUX26_DEFCONFIG = "at91sam9260ek_defconfig"
UBOOT_MACHINE = "at91sam9260ek_dataflash_cs1_config"
AT91BOOTSTRAP_BOARD = "at91sam9260df"

MACHINE_FEATURES += "usbhost"
```

## conf/machine/at91sam9260dfc.conf
```bitbake
#@TYPE: Machine
#@Name: Atmel AT91SAM9260EK Development Platform
#@DESCRIPTION: Machine configuration for the at91sam9260ek development board with a at91sam9260 processor
#@This configuration will boot from an external dataflashcard.

include conf/machine/include/AT91.inc

# Has no linux config file in OpenEmbedded
LINUX26_DEFCONFIG = "at91sam9260ek_defconfig"
UBOOT_MACHINE = "at91sam9260ek_dataflash_cs0_config"
AT91BOOTSTRAP_BOARD = "at91sam9260dfc"

MACHINE_FEATURES += "usbhost"
```

## conf/machine/at91sam9260ek.conf
```bitbake
#@TYPE: Machine
#@Name: Atmel AT91SAM9260EK Development Platform
#@DESCRIPTION: Machine configuration for the at91sam9260ek development board with a at91sam9260 processor


include conf/machine/include/AT91.inc

# Has no linux config file in OpenEmbedded
LINUX26_DEFCONFIG = "at91sam9260ek_defconfig"
UBOOT_MACHINE = "at91sam9260ek_config"
AT91BOOTSTRAP_BOARD = "at91sam9260ek"

MACHINE_FEATURES += "usbhost"
```

## conf/machine/at91sam9260nf.conf
```bitbake
#@TYPE: Machine
#@Name: Atmel AT91SAM9260EK Development Platform
#@DESCRIPTION: Machine configuration for the at91sam9260ek development board with a at91sam9260 processor
#@This configuration will boot from NAND Flash

include conf/machine/include/AT91.inc

# Has no linux config file in OpenEmbedded
LINUX26_DEFCONFIG = "at91sam9260ek_defconfig"
UBOOT_MACHINE = "at91sam9260ek_nandflash_config"
AT91BOOTSTRAP_BOARD = "at91sam9260nf"

MACHINE_FEATURES += "usbhost"
```

## conf/machine/at91sam9261ek.conf
```bitbake
#@TYPE: Machine
#@Name: Atmel AT91SAM9261EK Development Platform
#@DESCRIPTION: Machine configuration for the at91sam9261ek development board with a at91sam9261 processor


include conf/machine/include/AT91-LCD.inc

# Has no linux config file in OpenEmbedded
LINUX26_DEFCONFIG = "at91sam9261ek_defconfig"
UBOOT_MACHINE = "at91sam9261ek_config"
AT91BOOTSTRAP_BOARD = "at91sam9261ek"

MACHINE_FEATURES += "usbhost"
```

## conf/machine/at91sam9263dfc.conf
```bitbake
#@TYPE: Machine
#@Name: Atmel AT91SAM9263EK Development Platform
#@DESCRIPTION: Machine configuration for the at91sam9263ek development board with a at91sam9263 processor


include conf/machine/include/AT91-LCD.inc

# Has linux config file in OpenEmbedded
# LINUX26_DEFCONFIG = "at91sam9263ek_defconfig"
UBOOT_MACHINE = "at91sam9263ek_dataflash_cs0_config"
AT91BOOTSTRAP_BOARD = "at91sam9263dfc"

MACHINE_FEATURES += "usbhost"
```

## conf/machine/at91sam9g10df.conf
```bitbake
#@TYPE: Machine
#@Name: Atmel AT91SAM9G10EK Development Platform
#@DESCRIPTION: Machine configuration for the at91sam9g10ek development board with a at91sam9g10 processor
#@This configuration will boot from the internal dataflash

include conf/machine/include/AT91-LCD.inc

# Has linux config file in OpenEmbedded
# LINUX26_DEFCONFIG = "at91sam9g10ek_defconfig"
UBOOT_MACHINE = "at91sam9g10ek_dataflash_cs0_config"
AT91BOOTSTRAP_BOARD = "at91sam9g10df"

MACHINE_FEATURES += "usbhost"
```

## conf/machine/at91sam9g10nf.conf
```bitbake
#@TYPE: Machine
#@Name: Atmel AT91SAM9G10EK Development Platform
#@DESCRIPTION: Machine configuration for the at91sam9g10ek development board with a at91sam9g10 processor
#@This configuration will boot from NAND Flash

include conf/machine/include/AT91-LCD.inc

# Has linux config file in OpenEmbedded
# LINUX26_DEFCONFIG = "at91sam9g10ek_defconfig"
UBOOT_MACHINE = "at91sam9g10ek_nandflash_config"
AT91BOOTSTRAP_BOARD = "at91sam9g10nf"

MACHINE_FEATURES += "usbhost"
```

## conf/machine/at91sam9g20dfc.conf
```bitbake
#@TYPE: Machine
#@Name: Atmel AT91SAM9G20EK Development Platform
#@DESCRIPTION: Machine configuration for the at91sam9g20ek development board with a at91sam9g20 processor
#@This configuration will boot from an external dataflashcard.

include conf/machine/include/AT91.inc

# Has linux config file in OpenEmbedded
# LINUX26_DEFCONFIG = "at91sam9g20ek_defconfig"
UBOOT_MACHINE = "at91sam9g20ek_dataflash_cs0_config"
AT91BOOTSTRAP_BOARD = "at91sam9g20dfc"

MACHINE_FEATURES += "usbhost"
```

## conf/machine/at91sam9g20ek.conf
```bitbake
#@TYPE: Machine
#@Name: Atmel AT91SAM9G20EK Development Platform
#@DESCRIPTION: Machine configuration for the at91sam9g20ek development board with a at91sam9g20 processor


include conf/machine/include/AT91.inc

# Has linux config file in OpenEmbedded
# LINUX26_DEFCONFIG = "at91sam9g20ek_defconfig"
UBOOT_MACHINE = "at91sam9g20ek_config"
AT91BOOTSTRAP_BOARD = "at91sam9g20ek"

MACHINE_FEATURES += "usbhost"
```

## conf/machine/at91sam9g45ek.conf
```bitbake
#@TYPE: Machine
#@Name: Atmel AT91SAM9G45EK Development Platform
#@DESCRIPTION: Machine configuration for the at91sam9g45ek development board with a at91sam9g45-ES processor
# Once a at91sam9g45ek development board with a production at91sam9g45 processor
# is available we should change the recipe to use the at91sam9m10g45ek_defconfig

include conf/machine/include/AT91-LCD.inc

# Has linux config file in OpenEmbedded
# LINUX26_DEFCONFIG = "at91sam9g45ek_defconfig"
UBOOT_MACHINE = "at91sam9g45ekes_config"
AT91BOOTSTRAP_BOARD = "at91sam9g45ekes"

# LINUX26_DEFCONFIG = "at91sam9m10g45ek_defconfig"
# UBOOT_MACHINE = "at91sam9m10g45ek_defconfig"
# Not sure we have a board?
# AT91BOOTSTRAP_BOARD = "at91sam9g45???"

MACHINE_FEATURES += "usbhost"
```

## conf/machine/at91sam9g45ekes.conf
```bitbake
#@TYPE: Machine
#@Name: Atmel AT91SAM9G45EK Development Platform
#@DESCRIPTION: Machine configuration for the at91sam9g45ek development board with a at91sam9g45-ES processor


include conf/machine/include/AT91-LCD.inc

# Has linux config file in OpenEmbedded, no ekes in linux...
# LINUX26_DEFCONFIG = "at91sam9g45ek_defconfig"
UBOOT_MACHINE = "at91sam9g45ekes_dataflash_cs0_config"

# Boot from Dataflash, so we do not have to reprogram
# At91bootstrap/U-Boot everytime we erase the NAND flash
AT91BOOTSTRAP_BOARD = "at91sam9g45dfes"

MACHINE_FEATURES += "usbhost"
```

## conf/machine/at91sam9m10ek.conf
```bitbake
#@TYPE: Machine
#@Name: Atmel AT91SAM9G45EK Development Platform
#@DESCRIPTION: Machine configuration for the at91sam9g45ek development board with a at91sam9m10/g45 processor
# This lacks a linux definition file. Not yet available so it will bomb!

include conf/machine/include/AT91-LCD.inc

# Has no linux config file in OpenEmbedded
LINUX26_DEFCONFIG = "at91sam9m10g45ek_defconfig"
UBOOT_MACHINE = "at91sam9m10g45ek_dataflash_cs0_config"

# Boot from Dataflash, so we do not have to reprogram
# At91bootstrap/U-Boot everytime we erase the NAND flash
AT91BOOTSTRAP_BOARD = "at91sam9m10df"

MACHINE_FEATURES += "usbhost"
```

## conf/machine/at91sam9rlek.conf
```bitbake
#@TYPE: Machine
#@Name: Atmel AT91SAM9RLEK Development Platform
#@DESCRIPTION: Machine configuration for the at91sam9rlek development board with a at91sam9rl64 processor


include conf/machine/include/AT91-LCD.inc

# Has no linux config file in OpenEmbedded
LINUX26_DEFCONFIG = "at91sam9rlek_defconfig"
UBOOT_MACHINE = "at91sam9rlek_config"
AT91BOOTSTRAP_BOARD = "at91sam9rlek"

# MACHINE_FEATURES += "usbhost" - no host on this one!
```

## conf/machine/at91sam9xedfc.conf
```bitbake
#@TYPE: Machine
#@Name: Atmel AT91SAM9XEEK Development Platform
#@DESCRIPTION: Machine configuration for the at91sam9xeek development board with a at91sam9xe processor
#@This configuration will boot from an external dataflashcard.

include conf/machine/include/AT91.inc

# Has linux config file in OpenEmbedded
# LINUX26_DEFCONFIG = "at91sam9xeek_defconfig"
UBOOT_MACHINE = "at91sam9xeek_dataflash_cs0_config"
AT91BOOTSTRAP_BOARD = "at91sam9xedfc"

MACHINE_FEATURES += "usbhost"
```

## conf/machine/include/AT91-LCD.inc
```bitbake
# Common description for Atmel ARM processors with LCD controller

include conf/machine/include/AT91.inc

MACHINE_FEATURES += "screen touchscreen"
```

## conf/machine/include/AT91.inc
```bitbake
# Common description for Atmel ARM processors

TARGET_ARCH = "arm"
#PACKAGE_EXTRA_ARCHS = "armv4t armv5te"

PREFERRED_PROVIDER_virtual/kernel = "linux"
PREFERRED_VERSION_linux = "2.6.30.2"
PREFERRED_PROVIDER_xserver = "xserver-kdrive"
PREFERRED_PROVIDER_at91bootstrap = "at91bootstrap_2.13-rc1"
PREFERRED_PROVIDER_u-boot = "u-boot_2009.08-rc2"

KERNEL_IMAGETYPE = "uImage"

PREFERRED_VERSION_at91bootstrap = "2.13-rc1"
PREFERRED_VERSION_u-boot = "2009.08-rc2"
# PREFERRED_VERSION_mplayer = "svn"

#don't try to access tty1
USE_VT = "0"

MACHINE_FEATURES = "kernel26 alsa ext2 usbgadget vfat uboot"
MACHINE_EXTRA_RDEPENDS += "mpg321 mpd madplay mplayer libmad"
MACHINE_EXTRA_RDEPENDS += "kernel-modules"
MACHINE_EXTRA_RDEPENDS += "minicom"
MACHINE_EXTRA_RDEPENDS += "samba vsftpd"
MACHINE_EXTRA_RDEPENDS += "nano"
# MACHINE_EXTRA_RDEPENDS += "u-boot-utils"


EXTRA_IMAGEDEPENDS += "u-boot"
EXTRA_IMAGEDEPENDS += "at91bootstrap"


# used by sysvinit_2
SERIAL_CONSOLE = "115200 ttyS0"
IMAGE_FSTYPES ?= "jffs2"
EXTRA_IMAGECMD_jffs2 = "--pad --little-endian --eraseblock=0x20000 -n"
#
# Uncomment or add kernel modules that should be autoloaded
#module_autoload_g_file_storage = ${@base_contains('MACHINE_FEATURES', 'usbgadget',  'g_file_storage', '',d)}
#module_autoload_g_ether        = ${@base_contains('MACHINE_FEATURES', 'usbgadget',  'g_ether', '',d)}
module_autoload_g_serial       = ${@base_contains('MACHINE_FEATURES', 'usbgadget',  'g_serial', '',d)}

require conf/machine/include/tune-arm926ejs.inc
```
